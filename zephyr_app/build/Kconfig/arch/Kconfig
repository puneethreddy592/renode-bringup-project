## zephyr_app/build/Kconfig/arch/Kconfig
```kconfig
# Load Zephyr Arch Kconfig descriptions.
osource "/home/puneeth/zephyrproject/zephyr/arch/tricore/Kconfig"
osource "/home/puneeth/zephyrproject/zephyr/arch/hexagon/Kconfig"
osource "/home/puneeth/zephyrproject/zephyr/arch/rx/Kconfig"
osource "/home/puneeth/zephyrproject/zephyr/arch/x86/Kconfig"
osource "/home/puneeth/zephyrproject/zephyr/arch/xtensa/Kconfig"
osource "/home/puneeth/zephyrproject/zephyr/arch/sparc/Kconfig"
osource "/home/puneeth/zephyrproject/zephyr/arch/riscv/Kconfig"
osource "/home/puneeth/zephyrproject/zephyr/arch/posix/Kconfig"
osource "/home/puneeth/zephyrproject/zephyr/arch/openrisc/Kconfig"
osource "/home/puneeth/zephyrproject/zephyr/arch/mips/Kconfig"
osource "/home/puneeth/zephyrproject/zephyr/arch/arm64/Kconfig"
osource "/home/puneeth/zephyrproject/zephyr/arch/arm/Kconfig"
osource "/home/puneeth/zephyrproject/zephyr/arch/arc/Kconfig"
```

## zephyr_app/build/Kconfig/boards/Kconfig.defconfig
```kconfig
# Load Zephyr board defconfig descriptions.
osource "/home/puneeth/zephyrproject/zephyr/boards/antmicro/stm32h7_renode_reference_board/Kconfig.defconfig"
```

## zephyr_app/build/Kconfig/boards/Kconfig.stm32h7_renode_reference_board
```kconfig
# Load board Kconfig descriptions.
osource "/home/puneeth/zephyrproject/zephyr/boards/antmicro/stm32h7_renode_reference_board/Kconfig.stm32h7_renode_reference_board"
```

## zephyr_app/build/Kconfig/boards/Kconfig.sysbuild
```kconfig
# Load Sysbuild board Kconfig descriptions.
osource "/home/puneeth/zephyrproject/zephyr/boards/antmicro/stm32h7_renode_reference_board/Kconfig.sysbuild"
```

## zephyr_app/drivers/event_counter/Kconfig
```kconfig
config EVENT_COUNTER
	bool "Event counter driver"
	default y
	depends on DT_HAS_ZEPHYR_EVENT_COUNTER_ENABLED
	help
	  Enable driver for the custom simulated event counter peripheral.

if EVENT_COUNTER

config EVENT_COUNTER_INIT_PRIORITY
	int "Event counter init priority"
	default 90

module = EVENT_COUNTER
module-str = event counter
source "subsys/logging/Kconfig.template.log_config"

endif # EVENT_COUNTER
```
